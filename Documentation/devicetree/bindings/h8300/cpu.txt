## Documentation/devicetree/bindings/h8300/cpu.txt
```
* H8/300 CPU bindings

Required properties:

- compatible: Compatible property value should be "renesas,h8300".
- reg: Contains CPU index.
- clock-frequency: Contains the clock frequency for CPU, in Hz.
- renesas,bus-width: Contain the memory bus width.

Example:

		cpu@0 {
			compatible = "renesas,h8300";
			reg = <0>;
			clock-frequency = <20000000>;
			renesas,bus-width = <16>;
		};
```

## Documentation/devicetree/bindings/interrupt-controller/renesas,h8300h-intc.txt
```
* H8/300H Interrupt controler

Required properties:

- compatible: has to be "renesas,h8300h-intc", "renesas,h8300-intc" as fallback.
- #interrupt-cells: has to be <1>: an interrupt index and flags, as defined in
  interrupts.txt in this directory

Optional properties:

- any properties, listed in interrupts.txt, and any standard resource allocation
  properties

Example:

	h8intc: intc@0 {
		compatible = "renesas,h8300h-intc", "renesas,h8300-intc";
		#interrupt-cells = <1>;
		interrupt-controller;
	};
```

## Documentation/devicetree/bindings/interrupt-controller/renesas,h8s-intc.txt
```
* H8S Interrupt controler

Required properties:

- compatible: has to be "renesas,h8s-intc", "renesas,h8300-intc" as fallback.
- #interrupt-cells: has to be <1>: an interrupt index and flags, as defined in
  interrupts.txt in this directory

Optional properties:

- any properties, listed in interrupts.txt, and any standard resource allocation
  properties

Example:

	h8intc: intc@0 {
		compatible = "renesas,h8s-intc", "renesas,h8300-intc";
		#interrupt-cells = <1>;
		interrupt-controller;
	};
```

## Documentation/devicetree/bindings/net/ne2000.txt
```
NE2000 compatible network controller

Required properties:
- compatible: "national,ne2000"
- reg: base address and length of NE2000.
- interrupts: interrupt specifier for the sole interrupt.
- national,dcr: DCR setting value.

Example

	ne2000: ethernet@200000 {
		compatible = "national,ne2000";
		reg = <0x200000 32>;
		interrupts = <17 0>;
		national,dcr = <0x48>;
	};
```

## arch/h8300/Kconfig
```kconfig
config H8300
	bool
	default y
	select HAVE_IDE
	select GENERIC_ATOMIC64
	select HAVE_UID16
	select VIRT_TO_BUS
	select ARCH_WANT_IPC_PARSE_VERSION
	select GENERIC_IRQ_SHOW
	select FRAME_POINTER
	select GENERIC_CPU_DEVICES
	select MODULES_USE_ELF_RELA
	select GENERIC_CLOCKEVENTS
	select CLKDEV_LOOKUP
	select COMMON_CLK
	select HAVE_ARCH_TRACEHOOK
	select ARCH_WANT_FRAME_POINTERS

config MMU
	bool
	default n

config SWAP
	bool
	default n

config ZONE_DMA
	bool
	default y

config FPU
	bool
	default n

config RWSEM_GENERIC_SPINLOCK
	bool
	default y

config RWSEM_XCHGADD_ALGORITHM
	bool
	default n

config ARCH_HAS_ILOG2_U32
	bool
	default n

config ARCH_HAS_ILOG2_U64
	bool
	default n

config GENERIC_HWEIGHT
	bool
	default y

config GENERIC_CALIBRATE_DELAY
	bool
	default y

config GENERIC_BUG
        bool
        depends on BUG

config TIME_LOW_RES
	bool
	default y

config NO_IOPORT_MAP
	def_bool y

config NO_DMA
	def_bool n

config ISA
        def_bool n

config PCI
	def_bool n

config HZ
	int
	default 100

config NR_CPUS
        int
	default 1

source "init/Kconfig"

source "kernel/Kconfig.freezer"

source "arch/h8300/Kconfig.cpu"

menu "Kernel Features"

source "kernel/Kconfig.preempt"

source "mm/Kconfig"

endmenu

menu "Executable file formats"

source "fs/Kconfig.binfmt"

endmenu

source "net/Kconfig"

source "drivers/Kconfig"

source "fs/Kconfig"

source "arch/h8300/Kconfig.debug"

source "security/Kconfig"

source "crypto/Kconfig"

source "lib/Kconfig"
```

## arch/h8300/Kconfig.cpu
```kconfig
menu "Processor type and features"

choice
	prompt "H8/300 platform"

config H8300_AE3068
	bool "AE-3068/69"
	select H83069
	select RAMKERNEL
	help
	  AKI-H8/3068F / AKI-H8/3069F Flashmicom LAN Board Support
	  More Information. (Japanese Only)
	  <http://akizukidenshi.com/catalog/default.aspx>
	  AE-3068/69 Evaluation Board Support
	  More Information.
	  <http://www.microtronique.com/ae3069lan.htm>

config H8300_H8MAX
	bool "H8MAX"
	select H83069
	select RAMKERNEL
	help
	  H8MAX Evaluation Board Support
	  More Information. (Japanese Only)
	  <http://strawberry-linux.com/h8/index.html>

config H8300_KANEBEBE
	bool "KaneBebe"
	select H83069
	select RAMKERNEL
	help
	  KaneBebe Evalition Board Support

config H8300H_SIM
	bool "H8/300H GDB Simulator"
	select H83069
	select ROMKERNEL
	help
	  GDB Simulator Support
	  More Information.
	  <http://sourceware.org/sid/>

config H8S_EDOSK2674
	bool "EDOSK-2674"
	select H8S2678
	select RAMKERNEL
	help
	  Renesas EDOSK-2674 Evaluation Board Support
	  More Information.
	  <http://www.azpower.com/H8-uClinux/index.html>
 	  <http://www.renesas.eu/products/tools/introductory_evaluation_tools/evaluation_development_os_kits/edosk2674r/edosk2674r_software_tools_root.jsp>

config H8S_SIM
	bool "H8S GDB Simulator"
	select H8S2678
	select ROMKERNEL
	help
	  GDB Simulator Support
	  More Information.
	  <http://sourceware.org/sid/>

endchoice

choice
	prompt "CPU Selection"

config H83069
	bool "H8/3065,3066,3067,3068,3069"
	select CPU_H8300H
	select H8300_TMR8
	select H8300_TMR16

config H8S2678
	bool "H8S/2670,2673,2674R,2675,2676"
	select CPU_H8S
	select H8300_TMR8
	select H8300_TPU

endchoice

config CPU_CLOCK
	int "CPU Clock Frequency"
	depends on ROMKERNEL
	default "200000000" if H8300H_AKI3068NET || H8300H_SIM
	default "250000000" if H8300H_H8MAX || H8300H_KANEBEBE
	default "333333333" if H8S_EDOSK2674 || H8S_SIM
	help
	  CPU Clock Frequency

choice
	prompt "Kernel executes from"
	---help---
	  Choose the memory type that the kernel will be running in.

config RAMKERNEL
	bool "RAM"
	help
	  The kernel will be resident in RAM when running.

config ROMKERNEL
	bool "ROM"
	help
	  The kernel will be resident in FLASH/ROM when running.
endchoice

config CPU_H8300H
	bool
	depends on H83069
	default y

config CPU_H8S
	bool
	depends on H8S2678
	default y

config ROMSIZE
	hex "ROM size"
	depends on ROMKERNEL
	default 0x200000

config RAMBASE
	hex "RAM base address"
	default 0x400000

config RAMSIZE
	hex "RAM size"
	depends on ROMKERNEL
	default 0x200000 if H8300_AE3068 || H8300_H8MAX || H8300H_SIM
	default 0x400000 if H8300_KANEBEBE
	default 0x800000 if H8S_EDOSK2674 || H8S_SIM

config OFFSET
        hex "Load offset"
	default 0

endmenu
```

## arch/h8300/Kconfig.debug
```kconfig
menu "Kernel hacking"

source "lib/Kconfig.debug"

config FULLDEBUG
	bool "Full Symbolic/Source Debugging support"
	help
	  Enable debugging symbols on kernel build.

config HIGHPROFILE
	bool "Use fast second timer for profiling"
	help
	  Use a fast secondary clock to produce profiling information.

config NO_KERNEL_MSG
	bool "Suppress Kernel BUG Messages"
	help
	  Do not output any debug BUG messages within the kernel.

config SH_STANDARD_BIOS
       def_bool n

endmenu
```

## arch/rx/Kconfig
```kconfig
#
# For a description of the syntax of this configuration file,
# see Documentation/kbuild/kconfig-language.txt.
#

config RX
        def_bool y
	select HAVE_CLK
	select HAVE_SYSCALL_TRACEPOINTS
	select HAVE_KERNEL_GZIP
	select HAVE_KERNEL_LZO
	select HAVE_DMA_ATTRS
	select HAVE_GENERIC_DMA_COHERENT
	select GENERIC_ATOMIC64
	select HAVE_UID16
	select VIRT_TO_BUS
	select IRQ_DOMAIN
	select OF
	select OF_IRQ
	select OF_FLATTREE
	select HAVE_MEMBLOCK
	select NO_BOOTMEM
	select OF_EARLY_FLATTREE
	select COMMON_CLK
	select CLKSRC_OF
	select GENERIC_CLOCKEVENTS
	select HAVE_EFFICIENT_UNALIGNED_ACCESS
	select DMA_DIRECT_OPS
	select TIMER_OF
	select GENERIC_CPU_DEVICES
	select GENERIC_IRQ_SHOW
	select UACCESS_MEMCPY
	select ARCH_HAS_BINFMT_FLAT

config MMU
	def_bool n

config SWAP
	def_bool n

config ZONE_DMA
	def_bool n

config FPU
	def_bool n

config RWSEM_GENERIC_SPINLOCK
	def_bool y

config RWSEM_XCHGADD_ALGORITHM
	def_bool n

config ARCH_HAS_ILOG2_U32
	def_bool n

config ARCH_HAS_ILOG2_U64
	def_bool n

config GENERIC_FIND_NEXT_BIT
	def_bool y

config GENERIC_HWEIGHT
	def_bool y

config GENERIC_HARDIRQS
	def_bool y

config GENERIC_TIME
	def_bool y

config GENERIC_BUG
        bool
        depends on BUG

config GENERIC_CSUM
        def_bool y

config NEED_SG_DMA_LENGTH
        def_bool y

config TIME_LOW_RES
	def_bool y

config NO_IOPORT
	def_bool y

config NO_DMA
	def_bool n

config ISA
       def_bool n

config PCI
	bool
	default n

config HZ
	int
	default 100

config NR_CPUS
	int
	default 1

config GENERIC_IRQ_SHOW
       def_bool y

source "kernel/Kconfig.freezer"

menu "Processor type and features"

choice
	prompt "Platform"
	default RX_QEMU

config RX_QEMU
	bool "QEMU virtual platform"
	select CPU_RX62N
	help
	  GDB Simulator

config TKDN_RX62N
	bool "TKDN-RX62N-BRD"
	select CPU_RX62N
	help
	  TokushuDenshiKairo Inc, Ultimate RX62N Board (NP1040)

config RXMEGA
	bool "FRK-62N w/ RX-MEGA"
	select CPU_RX62N
	help
	  CQ publising, FRK-RX62N with TokushuDenshiKairo Inc, RX-MEGA expantion board.

config AP_RX64M
	bool "AP-RX64M-0A"
	select CPU_RX64M
endchoice

config CPU_RX610
       bool
       select RX_ICUA
       select RX_TPU
       select RX_CMT

config CPU_RX62N
       bool
       select RX_ICUA
       select RX_TPU
       select RX_CMT

config CPU_RX64M
       bool
       select RXV2
       select RX_ICUA

config RX_ICUA
       bool

config CPU_LITTLE_ENDIAN
       def_bool y

menu "memory map"
config RAMSTART
       hex "RAM start address"
config RAMEND
       hex "RAM end address"
config INITIAL_STACK
       hex "Initial stack address"
config BOOT_LINK_OFFSET
       hex "Link offset of zImage"
endmenu

endmenu
```

## arch/rx/Kconfig.debug
```kconfig
menu "Kernel Hacking"

config EARLY_PRINTK
        bool "Early printk support"

endmenu
```

## arch/rx/configs/rx-virt_defconfig
```kconfig
# CONFIG_LOCALVERSION_AUTO is not set
CONFIG_NAMESPACES=y
# CONFIG_SYSFS_SYSCALL is not set
# CONFIG_ELF_CORE is not set
# CONFIG_BASE_FULL is not set
# CONFIG_FUTEX is not set
# CONFIG_EPOLL is not set
# CONFIG_SIGNALFD is not set
# CONFIG_TIMERFD is not set
# CONFIG_EVENTFD is not set
# CONFIG_KALLSYMS is not set
CONFIG_EMBEDDED=y
# CONFIG_VM_EVENT_COUNTERS is not set
# CONFIG_COMPAT_BRK is not set
CONFIG_SLOB=y
# CONFIG_BLOCK is not set
CONFIG_BINFMT_FLAT=y
# CONFIG_STANDALONE is not set
# CONFIG_PREVENT_FIRMWARE_BUILD is not set
# CONFIG_INPUT is not set
# CONFIG_SERIO is not set
# CONFIG_VT is not set
# CONFIG_UNIX98_PTYS is not set
# CONFIG_LEGACY_PTYS is not set
CONFIG_SERIAL_SH_SCI=y
CONFIG_SERIAL_SH_SCI_EARLYCON=y
# CONFIG_HW_RANDOM is not set
# CONFIG_DEVMEM is not set
# CONFIG_HWMON is not set
# CONFIG_USB_SUPPORT is not set
# CONFIG_FILE_LOCKING is not set
# CONFIG_DNOTIFY is not set
# CONFIG_INOTIFY_USER is not set
# CONFIG_PROC_SYSCTL is not set
# CONFIG_SYSFS is not set
# CONFIG_MISC_FILESYSTEMS is not set
CONFIG_DEBUG_INFO=y
# CONFIG_SCHED_DEBUG is not set
```

## arch/rx/configs/rxsim_defconfig
```kconfig
# CONFIG_LOCALVERSION_AUTO is not set
# CONFIG_USELIB is not set
CONFIG_NAMESPACES=y
# CONFIG_BLK_DEV_INITRD is not set
# CONFIG_INITRAMFS_SOURCE is not set
# CONFIG_RD_GZIP is not set
# CONFIG_RD_BZIP2 is not set
# CONFIG_RD_LZMA is not set
# CONFIG_RD_XZ is not set
# CONFIG_RD_LZO is not set
# CONFIG_RD_LZ4 is not set
# CONFIG_SYSFS_SYSCALL is not set
# CONFIG_KALLSYMS is not set
# CONFIG_ELF_CORE is not set
# CONFIG_BASE_FULL is not set
# CONFIG_FUTEX is not set
# CONFIG_EPOLL is not set
# CONFIG_SIGNALFD is not set
# CONFIG_TIMERFD is not set
# CONFIG_EVENTFD is not set
CONFIG_EMBEDDED=y
# CONFIG_VM_EVENT_COUNTERS is not set
# CONFIG_COMPAT_BRK is not set
CONFIG_SLOB=y
# CONFIG_BLOCK is not set
CONFIG_RX_BUILTIN_DTB="rx_sim"
CONFIG_ROMKERNEL=y
CONFIG_ROMSTART=0xff000000
CONFIG_ROMEND=0xffffffff
CONFIG_RAMSTART=0x01000000
CONFIG_RAMEND=0x02000000
CONFIG_INITIAL_STACK=0x02000000
CONFIG_BOOT_LINK_OFFSET=0x0
CONFIG_BINFMT_FLAT=y
# CONFIG_UEVENT_HELPER is not set
# CONFIG_STANDALONE is not set
# CONFIG_PREVENT_FIRMWARE_BUILD is not set
# CONFIG_FIRMWARE_IN_KERNEL is not set
# CONFIG_INPUT is not set
# CONFIG_SERIO is not set
# CONFIG_VT is not set
# CONFIG_UNIX98_PTYS is not set
# CONFIG_LEGACY_PTYS is not set
# CONFIG_DEVMEM is not set
# CONFIG_DEVKMEM is not set
CONFIG_SERIAL_SH_SCI=y
CONFIG_SERIAL_SH_SCI_EARLYCON=y
# CONFIG_HW_RANDOM is not set
# CONFIG_HWMON is not set
# CONFIG_USB_SUPPORT is not set
# CONFIG_FILE_LOCKING is not set
# CONFIG_DNOTIFY is not set
# CONFIG_INOTIFY_USER is not set
# CONFIG_PROC_SYSCTL is not set
# CONFIG_SYSFS is not set
# CONFIG_MISC_FILESYSTEMS is not set
# CONFIG_ENABLE_WARN_DEPRECATED is not set
# CONFIG_ENABLE_MUST_CHECK is not set
# CONFIG_SCHED_DEBUG is not set
```

## arch/rx/configs/tkdn-rx62n_defconfig
```kconfig
# CONFIG_LOCALVERSION_AUTO is not set
CONFIG_KERNEL_LZO=y
# CONFIG_USELIB is not set
CONFIG_NAMESPACES=y
# CONFIG_SYSFS_SYSCALL is not set
# CONFIG_KALLSYMS is not set
# CONFIG_ELF_CORE is not set
# CONFIG_BASE_FULL is not set
# CONFIG_FUTEX is not set
# CONFIG_EPOLL is not set
# CONFIG_SIGNALFD is not set
# CONFIG_TIMERFD is not set
# CONFIG_EVENTFD is not set
CONFIG_EMBEDDED=y
# CONFIG_VM_EVENT_COUNTERS is not set
# CONFIG_COMPAT_BRK is not set
CONFIG_SLOB=y
# CONFIG_BLOCK is not set
CONFIG_TKDN_RX62N=y
CONFIG_RAMSTART=0x08000000
CONFIG_RAMEND=0x09000000
CONFIG_INITIAL_STACK=0x09000000
CONFIG_BOOT_LINK_OFFSET=0x00800000
CONFIG_BINFMT_FLAT=y
CONFIG_NET=y
CONFIG_INET=y
CONFIG_IP_PNP=y
CONFIG_IP_PNP_BOOTP=y
# CONFIG_INET_XFRM_MODE_TRANSPORT is not set
# CONFIG_INET_XFRM_MODE_TUNNEL is not set
# CONFIG_INET_XFRM_MODE_BEET is not set
# CONFIG_INET_LRO is not set
# CONFIG_INET_DIAG is not set
# CONFIG_IPV6 is not set
# CONFIG_WIRELESS is not set
# CONFIG_UEVENT_HELPER is not set
# CONFIG_STANDALONE is not set
# CONFIG_PREVENT_FIRMWARE_BUILD is not set
# CONFIG_FW_LOADER is not set
# CONFIG_ALLOW_DEV_COREDUMP is not set
CONFIG_NETDEVICES=y
# CONFIG_NET_CORE is not set
# CONFIG_NET_VENDOR_ARC is not set
# CONFIG_NET_CADENCE is not set
# CONFIG_NET_VENDOR_BROADCOM is not set
# CONFIG_NET_VENDOR_EZCHIP is not set
# CONFIG_NET_VENDOR_INTEL is not set
# CONFIG_NET_VENDOR_MARVELL is not set
# CONFIG_NET_VENDOR_MICREL is not set
# CONFIG_NET_VENDOR_NATSEMI is not set
# CONFIG_NET_VENDOR_QUALCOMM is not set
CONFIG_SH_ETH=y
# CONFIG_NET_VENDOR_ROCKER is not set
# CONFIG_NET_VENDOR_SAMSUNG is not set
# CONFIG_NET_VENDOR_SEEQ is not set
# CONFIG_NET_VENDOR_STMICRO is not set
# CONFIG_NET_VENDOR_SYNOPSYS is not set
# CONFIG_NET_VENDOR_VIA is not set
# CONFIG_NET_VENDOR_WIZNET is not set
CONFIG_SMSC_PHY=y
# CONFIG_WLAN is not set
# CONFIG_INPUT is not set
# CONFIG_SERIO is not set
# CONFIG_VT is not set
# CONFIG_UNIX98_PTYS is not set
# CONFIG_LEGACY_PTYS is not set
# CONFIG_DEVMEM is not set
# CONFIG_DEVKMEM is not set
CONFIG_SERIAL_SH_SCI=y
CONFIG_SERIAL_SH_SCI_EARLYCON=y
# CONFIG_HW_RANDOM is not set
# CONFIG_HWMON is not set
# CONFIG_USB_SUPPORT is not set
# CONFIG_DNOTIFY is not set
# CONFIG_INOTIFY_USER is not set
# CONFIG_SYSFS is not set
# CONFIG_MISC_FILESYSTEMS is not set
CONFIG_NFS_FS=y
CONFIG_ROOT_NFS=y
CONFIG_SUNRPC_DEBUG=y
CONFIG_DEBUG_INFO=y
# CONFIG_ENABLE_WARN_DEPRECATED is not set
# CONFIG_ENABLE_MUST_CHECK is not set
# CONFIG_SCHED_DEBUG is not set
CONFIG_XZ_DEC=y
```
